## python-src/batocera-launch/Config.in
```kconfig
config BR2_PACKAGE_BATOCERA_LAUNCH
	bool
	select BR2_PACKAGE_PYTHON3
	select BR2_PACKAGE_PYTHON_PYYAML
	select BR2_PACKAGE_PYTHON_RUAMEL_YAML
	select BR2_PACKAGE_PYTHON_TYPING_EXTENSIONS
	select BR2_PACKAGE_PYTHON_BATOCERA_COMMON
	select BR2_PACKAGE_PYTHON_EVDEV
	select BR2_PACKAGE_PYTHON_PYUDEV # for guns
	select BR2_PACKAGE_PYTHON_TOML
	select BR2_PACKAGE_PYTHON_PILLOW
	select BR2_PACKAGE_PYTHON_QRCODE # for retroachievement urls
	select BR2_PACKAGE_MANGOHUD      if (BR2_PACKAGE_WAYLAND || BR2_PACKAGE_XORG7 || BR2_PACKAGE_LIBDRM) && !BR2_PACKAGE_BATOCERA_TARGET_S905
	help
	  The emulator launcher for batocera.

config BR2_BATOCERA_LAUNCH_ARCH
	string
	default "x86_64" if BR2_PACKAGE_BATOCERA_TARGET_X86_64_ANY
	default BR2_BATOCERA_ARCH if !BR2_PACKAGE_BATOCERA_TARGET_X86_64_ANY
```
